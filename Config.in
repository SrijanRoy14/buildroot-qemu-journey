## Config.in
```kconfig
menu "Custom external packages"
    source "$BR2_EXTERNAL_EMLI_PATH/package/hello/Config.in"
endmenu
```

## package/hello/Config.in
```kconfig
config BR2_PACKAGE_HELLO
    bool "hello"
    help
      A simple hello world program.
```
